#include <physical_layouts.dtsi>

/ {
    physical_layout_s: physical_layout_0 {
        compatible = "zmk,physical-layout";
        display-name = "S Layout";
    };

    physical_layout_l: physical_layout_2 {
        compatible = "zmk,physical-layout";
        display-name = "S Layout";
    };
};
